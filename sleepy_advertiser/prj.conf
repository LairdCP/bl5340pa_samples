## CMakeLists.txt
```
#
# Copyright (c) 2023-2024 Laird Connectivity
#
# SPDX-License-Identifier: Apache-2.0

cmake_minimum_required(VERSION 3.20.0)

message(NOTICE "Board: ${BOARD}")

# Generate build ID based on UTC timestamp
string(TIMESTAMP build_time "%s" UTC)
message("build time: ${build_time}")
set(BUILD_TIME ${build_time})
# This configuration file will get automatically merged.
configure_file(${CMAKE_SOURCE_DIR}/build_time.conf.in ${CMAKE_BINARY_DIR}/generated_build_time.conf)

find_package(Zephyr REQUIRED HINTS $ENV{ZEPHYR_BASE})
project(sleepy_advertiser)

target_sources(app PRIVATE src/main.c)
```

## Kconfig
```
# Copyright (c) 2021 Nordic Semiconductor ASA
# Copyright (c) 2023-2024 Ezurio
#
# SPDX-License-Identifier: LicenseRef-Nordic-5-Clause

mainmenu "Nordic Sleepy Advertiser Demo"

config ADVERTISE
	bool "Allow device to advertise on startup"
	depends on BT
	help
	  If enabled, the device will advertise for SLEEP_DURATION_SECONDS
	  before going into system off mode.
	  If disabled, the device will not advertise.

config ADVERTISE_FAST
	bool "Advertise quickly"
	depends on ADVERTISE
	help
	  Reduce the amount of time required to obtain RF power measurements
	  using max hold. Increases current consumption.
	  When selected rate is approximately 30 ms.
	  When not selected rate is approximately 1 second.

config SCANNABLE
	bool "Advertise as scannable"
	depends on ADVERTISE
	help
	  Allow transmission of empty scan response.
	  Can be used to confirm GPIO states of FEM in receive mode.

config SLEEP_DURATION_SECONDS
	int "Seconds [to advertise] before going into system off"
	default 90

config BUILD_TIME
	string "UTC of build (from CMake)"
	default "0"

source "Kconfig.zephyr"
```

## Kconfig.sysbuild
```
#
# Copyright (c) 2023 Nordic Semiconductor
#
# SPDX-License-Identifier: LicenseRef-Nordic-5-Clause
#

config NRF_DEFAULT_IPC_RADIO
	default y

# Enable Bluetooth serialization to network core
config NETCORE_IPC_RADIO_BT_HCI_IPC
	default y if SOC_SERIES_NRF53X
	
source "${ZEPHYR_BASE}/share/sysbuild/Kconfig"
```

## sample.yaml
```
sample:
  name: Sleepy Advertiser
common:
  tags: power bluetooth
  build_only: true
tests:
  sample.boards.nrf.sleepy_advertiser:
    platform_allow: |
      nrf21540dk/nrf52840 bl5340_dvk/nrf5340/cpuapp bl5340pa_dvk/nrf5340/cpuapp
      nrf52840dk/nrf52840 nrf52dk/nrf52832 nrf51dk/nrf51822
      nrf5340dk/nrf5340/cpuapp bl652_dvk bl653_dvk bl654_dvk
      bl654_sensor_board
  sample.boards.nrf.sleepy_advertiser.mock_using_nrf52840:
    platform_allow: |
      nrf21540dk/nrf52840
    extra_args: MOCK_LCZ_FEM=y
  sample.boards.nrf.sleepy_advertiser.shield:
    platform_allow: |
      nrf5340dk/nrf5340/cpuapp
    extra_args: SHIELD=nrf21540ek_fwd hci_ipc_SHIELD=nrf21540ek
  sample.boards.nrf.sleepy_advertiser.mock_using_nrf5340:
    platform_allow: |
      nrf5340dk/nrf5340/cpuapp
    extra_args: SHIELD=nrf21540ek_fwd hci_ipc_SHIELD=nrf21540ek MOCK_LCZ_FEM=y
  sample.boards.nrf.sleepy_advertiser.bl5340_no_adv:
    platform_allow: |
      bl5340pa_dvk/nrf5340/cpuapp
    extra_configs:
      - CONFIG_ADVERTISE=n
  sample.boards.nrf.sleepy_advertiser.bl5340_internal_ant_no_adv:
    platform_allow: |
      bl5340pa_dvk/nrf5340/cpuapp
    extra_args: hci_ipc_CONFIG_LCZ_FEM_INTERNAL_ANTENNA=y
    extra_configs:
      - CONFIG_ADVERTISE=n
  sample.boards.nrf.sleepy_advertiser.other_options:
    platform_allow: |
      nrf21540dk/nrf52840 bl5340pa_dvk/nrf5340/cpuapp
    extra_configs:
      - CONFIG_ADVERTISE_FAST=y
      - CONFIG_SCANNABLE=y
      - CONFIG_SLEEP_DURATION_SECONDS=600
  sample.boards.nrf.sleepy_advertiser.timing:
    platform_allow: |
      bl5340pa_dvk/nrf5340/cpuapp
    extra_args:
      - LOG_TYPE=rtt
      - hci_ipc_CONFIG_LCZ_FEM_LOG_LEVEL_DBG=y
      - hci_ipc_CONFIG_LCZ_FEM_DEBUG_MODEL_TIMING=y
```

## prj.conf
```kconfig
# Sleepy Advertiser

# If Bluetooth is enabled, then a network CPU image will be generated (if applicable).
CONFIG_BT=y
# If Bluetooth is enabled, then the FEM GPIO will be initialized (if applicable).
CONFIG_ADVERTISE=y
CONFIG_BT_DEVICE_NAME="Sleepy Advertiser"

CONFIG_LOG=y
CONFIG_LOG_MODE_IMMEDIATE=y

# Required to disable default behavior of deep sleep on timeout
CONFIG_PM_DEVICE=y

CONFIG_POWEROFF=y
```

## src/main.c
```c
/*
 * Copyright (c) 2015-2016 Intel Corporation
 * Copyright (c) 2019 Nordic Semiconductor ASA
 * Copyright (c) 2023-2024 Ezurio
 *
 * SPDX-License-Identifier: Apache-2.0
 */
#include <zephyr/logging/log.h>
LOG_MODULE_REGISTER(main, CONFIG_LOG_DEFAULT_LEVEL);

#include <zephyr/kernel.h>
#include <zephyr/device.h>
#include <zephyr/init.h>
#include <zephyr/pm/device.h>
#include <zephyr/sys/poweroff.h>

#include <zephyr/bluetooth/bluetooth.h>

#define VERSION_STR "1.2.0." CONFIG_BUILD_TIME

#if defined(CONFIG_BT)
#define DEVICE_NAME	CONFIG_BT_DEVICE_NAME
#define DEVICE_NAME_LEN (sizeof(DEVICE_NAME) - 1)

#if defined(CONFIG_ADVERTISE)

#if defined(CONFIG_ADVERTISE_FAST)
#define RATE BT_GAP_ADV_FAST_INT_MIN_1
#else
#define RATE BT_GAP_ADV_SLOW_INT_MIN
#endif

#if defined(CONFIG_SCANNABLE)
#define OPT BT_LE_ADV_OPT_SCANNABLE
#else
#define OPT BT_LE_ADV_OPT_NONE
#endif

#define ADV_PARAM BT_LE_ADV_PARAM(OPT, RATE, (RATE + 1), NULL)

static const struct bt_data ad[] = {
	BT_DATA_BYTES(BT_DATA_FLAGS, BT_LE_AD_NO_BREDR),
	BT_DATA(BT_DATA_NAME_COMPLETE, DEVICE_NAME, DEVICE_NAME_LEN),
};
#endif
#endif

#if defined(CONFIG_BT)
static void start_advertising(void)
{
#if defined(CONFIG_ADVERTISE)
	int rc;

	rc = bt_le_adv_start(ADV_PARAM, ad, ARRAY_SIZE(ad), NULL, 0);
	LOG_INF("Advertising start: %d", rc);
#endif
}

static void bt_ready(int err)
{
	LOG_INF("Bluetooth ready: %d", err);
	if (err) {
		return;
	}

	start_advertising();
}
#endif

int main(void)
{
	int rc;
	int rc2;
	const struct device *const cons = DEVICE_DT_GET(DT_CHOSEN(zephyr_console));

	if (!device_is_ready(cons)) {
		LOG_ERR("%s: device not ready.", cons->name);
		return 0;
	}

	LOG_INF("BT sleepy advertiser on %s", CONFIG_BOARD);
	LOG_INF("Version %s\n", VERSION_STR);

#if defined(CONFIG_BT)
	rc = bt_enable(bt_ready);
	if (rc < 0) {
		LOG_ERR("Bluetooth init: %d", rc);
		return 0;
	}
	k_sleep(K_SECONDS(1));
#endif

	LOG_INF("Sleep %u s with UART off", CONFIG_SLEEP_DURATION_SECONDS);
	rc = pm_device_action_run(cons, PM_DEVICE_ACTION_SUSPEND);
	k_sleep(K_SECONDS(CONFIG_SLEEP_DURATION_SECONDS));
	rc2 = pm_device_action_run(cons, PM_DEVICE_ACTION_RESUME);
	LOG_INF("suspend status: %d resume status: %d", rc, rc2);

	LOG_INF("Entering system off; press reset button to restart");
	rc = pm_device_action_run(cons, PM_DEVICE_ACTION_SUSPEND);
	k_sleep(K_SECONDS(1));
	sys_poweroff();

	LOG_ERR("System off failed");
	return 0;
}
```
